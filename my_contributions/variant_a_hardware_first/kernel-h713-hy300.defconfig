## my_contributions/variant_a_hardware_first/kernel-h713-hy300.defconfig
```kconfig
# Kernel Configuration for HY300 Projector with Allwinner H713
# 
# Based on:
# - H6 SoC baseline (H713 is closely related)
# - sunxi.dts device tree analysis
# - HY300 hardware requirements
# 
# Generated: November 3, 2025
# Architecture: aarch64 (ARM64)
# Platform: Allwinner sun50i-h713 (H713 SoC)
# Kernel: Linux 6.16.7+

#
# Processor and Core Support
#

# ARM64 Core support
CONFIG_ARM64=y
CONFIG_PAGE_OFFSET=0xffff800000000000
CONFIG_SWIOTLB=y
CONFIG_IOMMU_SUPPORT=y

# CPU features
CONFIG_ARM_PSCI=y
CONFIG_ARM_PSCI_FW=y

# Performance monitoring
CONFIG_PERF_EVENTS=y
CONFIG_ARM_SPE_PMU=y

#
# General setup (Platform independent)
#

CONFIG_SMP=y
CONFIG_NR_CPUS=4
CONFIG_HAVE_EFFICIENT_IPI=y
CONFIG_HW_PERF_EVENTS=y

# Thermal management for projector cooling
CONFIG_THERMAL=y
CONFIG_THERMAL_SUN50I=y
CONFIG_THERMAL_OF=y
CONFIG_THERMAL_GOV_FAIR_SHARE=y
CONFIG_THERMAL_GOV_STEP_WISE=y
CONFIG_THERMAL_EMULATION=y

#
# Clock and Power Management
#

CONFIG_COMMON_CLK=y
CONFIG_SUNXI_CCU=y
CONFIG_SUNXI_GATE_CONTROLLER=y

# CPU frequency scaling for projector power management
CONFIG_CPU_FREQ=y
CONFIG_CPU_FREQ_GOV_ONDEMAND=y
CONFIG_CPU_FREQ_GOV_USERSPACE=y
CONFIG_CPUFREQ_DT=y
CONFIG_ARM_CPUFREQ_DT=y

# GPIO
CONFIG_GPIO_SYSFS=y
CONFIG_GPIO_SUNXI=y
CONFIG_PINCTRL=y
CONFIG_PINCTRL_SUN50I_H6=y

#
# Serial Console Support (CRITICAL for HY300 UART0)
#

CONFIG_SERIAL_CORE=y
CONFIG_SERIAL_8250=y
CONFIG_SERIAL_8250_CONSOLE=y
CONFIG_SERIAL_8250_DW=y
CONFIG_SERIAL_CORE_CONSOLE=y
CONFIG_SERIAL_OF_PLATFORM=y
CONFIG_SERIAL_EARLYCON=y

# UART support (UART0 @ PA4/PA5 @ 115200 baud)
CONFIG_SERIAL_AMBA_PL011=y
CONFIG_SERIAL_AMBA_PL011_CONSOLE=y

#
# I2C Support (GPIO expansion, motor control, sensors)
#

CONFIG_I2C=y
CONFIG_I2C_CHARDEV=y
CONFIG_I2C_SUNXI=y
CONFIG_I2C_MUX=y
CONFIG_I2C_MUX_GPIO=y
CONFIG_I2C_GPIO=y

#
# SPI Support (Projector motor/sensor interfaces)
#

CONFIG_SPI=y
CONFIG_SPI_SUNXI=y
CONFIG_SPI_SPIDEV=y

#
# PWM Support (Fan, LED, lamp control)
#

CONFIG_PWM=y
CONFIG_PWM_SUNXI=y
CONFIG_PWM_SYSFS=y

#
# RTC (Real-time clock)
#

CONFIG_RTC_CLASS=y
CONFIG_RTC_SUN6I=y

#
# Storage and Filesystems
#

# MMC/SD Card support (boot device)
CONFIG_MMC=y
CONFIG_MMC_SDHCI=y
CONFIG_MMC_SDHCI_PLTFM=y
CONFIG_MMC_SUNXI=y
CONFIG_MMC_SUNXI_DMA=y

# NAND support (if needed)
CONFIG_MTD=y
CONFIG_MTD_NAND=y
CONFIG_MTD_NAND_SUNXI=y

# Filesystem support
CONFIG_EXT4_FS=y
CONFIG_EXT4_FS_POSIX_ACL=y
CONFIG_VFAT_FS=y
CONFIG_NLS_CODEPAGE_437=y
CONFIG_NLS_ISO8859_1=y

#
# Graphics and Display (Mali GPU + HDMI/Video)
#

# Mali GPU support - Using Panfrost (open-source driver)
CONFIG_DRM=y
CONFIG_DRM_PANFROST=y
CONFIG_DRM_PANEL=y
CONFIG_DRM_PANEL_SIMPLE=y

# HDMI and video output
CONFIG_DRM_SUNXI=y
CONFIG_DRM_SUN4I=y
CONFIG_DRM_SUN6I=y

# Framebuffer (fallback display)
CONFIG_FB=y
CONFIG_FB_SIMPLE=y

# Video4Linux2 for video encoding/decoding
CONFIG_V4L2_CORE=y
CONFIG_V4L2_MEM2MEM_DEV=y

#
# Video Codec Support (H.264/H.265)
#

# Sunxi Video Engine drivers (H.264/H.265)
CONFIG_VIDEO_SUN6I_CEDRUS=y
CONFIG_VIDEOBUF2_DMA_CONTIG=y
CONFIG_VIDEOBUF2_VMALLOC=y

#
# Audio Support (AC200 Codec)
#

CONFIG_SOUND=y
CONFIG_SND=y
CONFIG_SND_SOC=y
CONFIG_SND_SOC_SUNXI=y
CONFIG_SND_SOC_AC200=y

#
# USB Support
#

CONFIG_USB=y
CONFIG_USB_DWC3=y
CONFIG_USB_DWC3_GENERIC=y
CONFIG_USB_OTG=y

#
# Networking
#

CONFIG_NET=y
CONFIG_INET=y
CONFIG_PACKET=y
CONFIG_UNIX=y

# Ethernet (if available on HY300)
CONFIG_NETDEVICES=y
CONFIG_SUNXI_GMAC=y

# WiFi/Bluetooth stubs (AIC8800 requires separate driver)
CONFIG_CFG80211=y
CONFIG_MAC80211=y

#
# Input devices (Projector remote/sensors)
#

CONFIG_INPUT=y
CONFIG_INPUT_EVDEV=y
CONFIG_INPUT_MISC=y

# IR receiver (HY300 has remote)
CONFIG_IR=y
CONFIG_IR_SUNXI=y

#
# Watchdog
#

CONFIG_WATCHDOG=y
CONFIG_SUNXI_WATCHDOG=y

#
# Misc
#

# Device Tree support
CONFIG_OF=y
CONFIG_OF_FLATTREE=y
CONFIG_OF_EARLY_FLATTREE=y
CONFIG_OF_ADDRESS=y
CONFIG_OF_GPIO=y

# Debugging
CONFIG_DEBUG_INFO=y
CONFIG_DEBUG_KERNEL=y
CONFIG_KGDB=y
CONFIG_KGDB_SERIAL_CONSOLE=y

# Crypto (secure boot support)
CONFIG_CRYPTO=y
CONFIG_CRYPTO_SHA256=y

# MIPS co-processor support (display firmware)
CONFIG_MIPS_LOADER=y
CONFIG_SUNXI_MIPS_LOADER=y

# Modules
CONFIG_MODULES=y
CONFIG_MODULE_UNLOAD=y

# Printk
CONFIG_PRINTK=y
CONFIG_PRINTK_TIME=y
CONFIG_PRINTK_CALLER=y

# Optimize for size but keep debugging
CONFIG_CC_OPTIMIZE_FOR_SIZE=y
CONFIG_STRIP_ASM_SYMS=y

# Boot parameters
CONFIG_BOOTPARAM_HUNG_TASK_PANIC=y
CONFIG_BOOTPARAM_HUNG_TASK_PANIC_VALUE=0

# Process accounting
CONFIG_TASKSTATS=y
CONFIG_ACCT=y

# Security
CONFIG_SECCOMP=y
CONFIG_HAVE_ARCH_SECCOMP_FILTER=y

# Misc safety features
CONFIG_MAGIC_SYSRQ=y
CONFIG_SYS_SUPPORTS_HUGETLBFS=y
CONFIG_HUGETLBFS=y
CONFIG_HUGETLB_PAGE=y
```
